#include <behaviors.dtsi>
#include <dt-bindings/zmk/keys.h>
#include <dt-bindings/zmk/bt.h>
#include <dt-bindings/zmk/outputs.h>
#include <dt-bindings/zmk/dynamic_nkro.h>

#include "zmk-helpers/helper.h"
#include "zmk-helpers/key-labels/42.h"

// docs
// https://github.com/zmkfirmware/zmk/blob/main/app/include/dt-bindings/zmk/keys.h
// https://zmk.dev/docs/keymaps/list-of-keycodes
// https://zmk.dev/docs/keymaps
// https://github.com/devicetree-org/devicetree-specification
// https://github.com/urob/zmk-helpers
// https://github.com/urob/zmk-helpers/blob/main/docs/core_helpers.md
// https://github.com/urob/zmk-config/tree/main#timeless-homerow-mods

// default keymap
// https://github.com/zmkfirmware/zmk/blob/main/app/boards/shields/corne/corne.keymap

// setup here
// https://github.com/urob/zmk-helpers?tab=readme-ov-file#installation

// lot's of commands work off of layer index
// let's give the layers names
// but we have to manually ensure the order

#define BASE_L 0
#define ED_L 1
#define NUM_L 2
#define FN_L 3
#define FN_2_L 4
#define SYS_L 5
#define _BLANK_L 6

ZMK_CONDITIONAL_LAYER(system_, NUM_L FN_L, SYS_L)
ZMK_CONDITIONAL_LAYER(fn_, NUM_L ED_L, FN_2_L)

/*
  ╭────────────────────────┬────────────────────────╮ ╭─────────────────────────┬─────────────────────────╮
  │  0   1   2   3   4   5 │  6   7   8   9  10  11 │ │ LT5 LT4 LT3 LT2 LT1 LT0 │ RT0 RT1 RT2 RT3 RT4 RT5 │
  │ 12  13  14  15  16  17 │ 18  19  20  21  22  23 │ │ LM5 LM4 LM3 LM2 LM1 LM0 │ RM0 RM1 RM2 RM3 RM4 RM5 │
  │ 24  25  26  27  28  29 │ 30  31  32  33  34  35 │ │ LB5 LB4 LB3 LB2 LB1 LB0 │ RB0 RB1 RB2 RB3 RB4 RB5 │
  ╰───────────╮ 36  37  38 │ 39  40  41 ╭───────────╯ ╰───────────╮ LH2 LH1 LH0 │ RH0 RH1 RH2 ╭───────────╯
              ╰────────────┴────────────╯                         ╰─────────────┴─────────────╯
*/

ZMK_COMBO(combo_backspace_l, &kp BSPC, LM1 LM2)
ZMK_COMBO(combo_backspace_r, &kp BSPC, RM1 RM2)
ZMK_COMBO(combo_del_l, &kp DEL, LT1 LT2)
ZMK_COMBO(combo_del_r, &kp DEL, RT1 RT2)

#define BACKTAB &kp LC(LS(TAB))
#define FRWDTAB &kp LC(TAB)
ZMK_COMBO(combo_forward_tab_l, FRWDTAB, LM2 LM3)
ZMK_COMBO(combo_back_tab_l, BACKTAB, LT2 LT3)
// ZMK_COMBO(combo_forward_tab_r, FRWDTAB, RM2 RM3)
// ZMK_COMBO(combo_back_tab_r, BACKTAB, RT2 RT3)

#define BACK &kp LA(LEFT)
#define FRWD &kp LA(RIGHT)
ZMK_COMBO(combo_forward_l, FRWD, LM3 LM4)
ZMK_COMBO(combo_back_l, BACK, LT3 LT4)
// ZMK_COMBO(combo_forward_r, FRWD, RM3 RM4)
// ZMK_COMBO(combo_back_r, BACK, RT3 RT4)

// tmux: prefix (ctrl+b) then p/n to switch active window
ZMK_MACRO(tmux_prev_window, bindings = <&kp LC(B) &kp P>;)
ZMK_MACRO(tmux_next_window, bindings = <&kp LC(B) &kp N>;)
ZMK_COMBO(combo_tmux_prev_window, &tmux_prev_window, RT2 RT3)
ZMK_COMBO(combo_tmux_next_window, &tmux_next_window, RM2 RM3)

ZMK_COMBO(triple_enter_l, &kp RET, LH2 LH1 LH0)

#define KEYS_L LT0 LT1 LT2 LT3 LT4 LT5 LM0 LM1 LM2 LM3 LM4 LM5 LB0 LB1 LB2 LB3 LB4 LB5
#define KEYS_R RT0 RT1 RT2 RT3 RT4 RT5 RM0 RM1 RM2 RM3 RM4 RM5 RB0 RB1 RB2 RB3 RB4 RB5
#define THUMBS LH0 LH1 LH2 RH0 RH1 RH2


// #define MO_TOG(layer) &behavior_mo_tog layer layer
// ZMK_HOLD_TAP(behavior_mo_tog,
//     flavor = "hold-preferred";
//     tapping-term-ms = <200>;
//     bindings = <&mo>, <&tog>;
// )

#define HOME_ROW_MODS_TAPPING_TERM_MS 280
#define HOME_ROW_MODS_REQUIRE_PRIOR_IDLE_MS 150
ZMK_HOLD_TAP(hml,
    flavor = "balanced";
    tapping-term-ms = <HOME_ROW_MODS_TAPPING_TERM_MS>;
    require-prior-idle-ms = <HOME_ROW_MODS_REQUIRE_PRIOR_IDLE_MS>;
    hold-trigger-key-positions = <KEYS_R THUMBS>;
    hold-trigger-on-release;
    bindings = <&kp>, <&kp>;
)

ZMK_HOLD_TAP(hmr,
    flavor = "balanced";
    tapping-term-ms = <HOME_ROW_MODS_TAPPING_TERM_MS>;
    require-prior-idle-ms = <HOME_ROW_MODS_REQUIRE_PRIOR_IDLE_MS>;
    hold-trigger-key-positions = <KEYS_L THUMBS>;
    hold-trigger-on-release;
    bindings = <&kp>, <&kp>;
)

//  unless defined otherwise I want no fall through by default
#define _____ &none
#define XXXXX &trans

// https://zmk.dev/docs/keymaps/list-of-keycodes
// https://github.com/urob/zmk-helpers/blob/main/docs/core_helpers.md

// ZMK_LAYER(debug,                                                                                                                                                                                       \
//      /* ╭─────────────┬─────────────┬─────────────┬─────────────┬─────────────┬─────────────╮                 ╭─────────────┬─────────────┬─────────────┬─────────────┬─────────────┬─────────────╮ */ \
//           &kp N1        &kp N1        &kp N1        &kp N1        &kp N1        &kp N1                          &kp N1        &kp N1        &kp N1        &kp N1        &kp N1        &kp N1           \
//      /* ├─────────────┼─────────────┼─────────────┼─────────────┼─────────────┼─────────────┤                 ├─────────────┼─────────────┼─────────────┼─────────────┼─────────────┼─────────────┤ */ \
//           &kp N1        &kp N1        &kp N1        &kp N1        &kp N1        &kp N1                          &kp N1        &kp N1        &kp N1        &kp N1        &kp N1        &kp N1           \
//      /* ├─────────────┼─────────────┼─────────────┼─────────────┼─────────────┼─────────────┤                 ├─────────────┼─────────────┼─────────────┼─────────────┼─────────────┼─────────────┤ */ \
//           &kp N1        &kp N1        &kp N1        &kp N1        &kp N1        &kp N1                          &kp N1        &kp N1        &kp N1        &kp N1        &kp N1        &kp N1           \
//      /* ╰─────────────┴─────────────┴─────────────┴──────┬─────────────┬─────────────┬──────┴──────╮   ╭──────┴──────┬──────┴──────┬──────┴──────┬──────┴─────────────┴─────────────┴─────────────╯ */ \
//                                                            &kp N1        &kp N1        &kp N1            &kp N1        &kp N1        &kp N1                                                            \
//      /*                                                  ╰─────────────┴─────────────┴─────────────╯   ╰─────────────┴─────────────┴─────────────╯                                                  */ \
// )

ZMK_LAYER(base,                                                                                                                                                                                        \
     /* ╭─────────────┬─────────────┬─────────────┬─────────────┬─────────────┬─────────────╮                 ╭─────────────┬─────────────┬─────────────┬─────────────┬─────────────┬─────────────╮ */ \
          &kp TAB       &kp Q         &kp W         &kp E         &kp R         &kp T                           &kp Y         &kp U         &kp I         &kp O         &kp P          &kp BSLH        \
     /* ├─────────────┼─────────────┼─────────────┼─────────────┼─────────────┼─────────────┤                 ├─────────────┼─────────────┼─────────────┼─────────────┼─────────────┼─────────────┤ */ \
          &kp ESC       &hml LGUI A   &hml LALT S   &hml LCTRL D  &kp F         &kp G                           &kp H         &kp J         &hmr RCTRL K  &hmr RALT L   &hmr RGUI SEMI &kp SQT         \
     /* ├─────────────┼─────────────┼─────────────┼─────────────┼─────────────┼─────────────┤                 ├─────────────┼─────────────┼─────────────┼─────────────┼─────────────┼─────────────┤ */ \
          &kp LSHFT     &kp Z         &kp X         &kp C         &kp V         &kp B                           &kp N         &kp M         &kp COMMA     &kp DOT       &kp FSLH       &kp RSHFT       \
     /* ╰─────────────┴─────────────┴─────────────┴──────┬─────────────┬─────────────┬──────┴──────╮   ╭──────┴──────┬──────┴──────┬──────┴──────┬──────┴─────────────┴─────────────┴─────────────╯ */ \
                                                           &mo NUM_L     &mo ED_L      &kp SPACE         &kp RET       &mo FN_L      _____                                                             \
     /*                                                  ╰─────────────┴─────────────┴─────────────╯   ╰─────────────┴─────────────┴─────────────╯                                                  */ \
)

ZMK_LAYER(editor,                                                                                                                                                                                      \
     /* ╭─────────────┬─────────────┬─────────────┬─────────────┬─────────────┬─────────────╮                 ╭─────────────┬─────────────┬─────────────┬─────────────┬─────────────┬─────────────╮ */ \
          &kp TAB       _____         _____         _____         &kp END       _____                           _____         &kp INS       &kp HOME      &kp PG_UP     &kp HOME      _____            \
     /* ├─────────────┼─────────────┼─────────────┼─────────────┼─────────────┼─────────────┤                 ├─────────────┼─────────────┼─────────────┼─────────────┼─────────────┼─────────────┤ */ \
          &kp ESC       &kp LGUI      &kp LALT      &kp LCTRL     _____         _____                           &kp LEFT      &kp DOWN      &kp UP        &kp RIGHT     _____         _____            \
     /* ├─────────────┼─────────────┼─────────────┼─────────────┼─────────────┼─────────────┤                 ├─────────────┼─────────────┼─────────────┼─────────────┼─────────────┼─────────────┤ */ \
          &kp LSHFT     _____         _____         _____         _____         _____                           _____         &kp DEL       &kp END       &kp PG_DN     _____         _____            \
     /* ╰─────────────┴─────────────┴─────────────┴──────┬─────────────┬─────────────┬──────┴──────╮   ╭──────┴──────┬──────┴──────┬──────┴──────┬──────┴─────────────┴─────────────┴─────────────╯ */ \
                                                           XXXXX         XXXXX         XXXXX             XXXXX         XXXXX         XXXXX                                                             \
     /*                                                  ╰─────────────┴─────────────┴─────────────╯   ╰─────────────┴─────────────┴─────────────╯                                                  */ \
)

ZMK_LAYER(num,                                                                                                                                                                                         \
     /* ╭─────────────┬─────────────┬─────────────┬─────────────┬─────────────┬─────────────╮                 ╭─────────────┬─────────────┬─────────────┬─────────────┬─────────────┬─────────────╮ */ \
          &kp TAB       &kp N1        &kp N2        &kp N3        &kp N4        &kp N5                          &kp N6        &kp N7        &kp N8        &kp N9        &kp N0        &kp EQUAL        \
     /* ├─────────────┼─────────────┼─────────────┼─────────────┼─────────────┼─────────────┤                 ├─────────────┼─────────────┼─────────────┼─────────────┼─────────────┼─────────────┤ */ \
          &kp ESC       &kp LGUI      &kp LALT      &kp LCTRL     _____         _____                           &kp MINUS     &kp PLUS      &kp RCTRL     &kp RALT      &kp RGUI      &kp GRAVE        \
     /* ├─────────────┼─────────────┼─────────────┼─────────────┼─────────────┼─────────────┤                 ├─────────────┼─────────────┼─────────────┼─────────────┼─────────────┼─────────────┤ */ \
          &kp LSHFT     _____         _____         _____         _____         _____                           _____         &kp LBKT      &kp RBKT      &kp DOT       &kp FSLH      &kp RSHFT        \
     /* ╰─────────────┴─────────────┴─────────────┴──────┬─────────────┬─────────────┬──────┴──────╮   ╭──────┴──────┬──────┴──────┬──────┴──────┬──────┴─────────────┴─────────────┴─────────────╯ */ \
                                                           XXXXX         XXXXX         XXXXX             XXXXX         XXXXX         XXXXX                                                             \
     /*                                                  ╰─────────────┴─────────────┴─────────────╯   ╰─────────────┴─────────────┴─────────────╯                                                  */ \
)

#define ZMK_LAYER_FN(layer_name)                                                                                                                                                                       \
ZMK_LAYER(layer_name,                                                                                                                                                                                  \
     /* ╭─────────────┬─────────────┬─────────────┬─────────────┬─────────────┬─────────────╮                 ╭─────────────┬─────────────┬─────────────┬─────────────┬─────────────┬─────────────╮ */ \
          &kp TAB       &kp F1        &kp F2        &kp F3        &kp F4        _____                           _____         _____         _____         _____         _____         _____            \
     /* ├─────────────┼─────────────┼─────────────┼─────────────┼─────────────┼─────────────┤                 ├─────────────┼─────────────┼─────────────┼─────────────┼─────────────┼─────────────┤ */ \
          &kp ESC       &kp F5        &kp F6        &kp F7        &kp F8        _____                           _____         _____         &kp RCTRL     &kp RALT      &kp RGUI      _____            \
     /* ├─────────────┼─────────────┼─────────────┼─────────────┼─────────────┼─────────────┤                 ├─────────────┼─────────────┼─────────────┼─────────────┼─────────────┼─────────────┤ */ \
          &kp LSHFT     &kp F9        &kp F10       &kp F11       &kp F12       _____                           _____         _____         _____         _____         _____         &kp RSHFT        \
     /* ╰─────────────┴─────────────┴─────────────┴──────┬─────────────┬─────────────┬──────┴──────╮   ╭──────┴──────┬──────┴──────┬──────┴──────┬──────┴─────────────┴─────────────┴─────────────╯ */ \
                                                           XXXXX         XXXXX         XXXXX             XXXXX         XXXXX         XXXXX                                                             \
     /*                                                  ╰─────────────┴─────────────┴─────────────╯   ╰─────────────┴─────────────┴─────────────╯                                                  */ \
)

ZMK_LAYER_FN(fn)
ZMK_LAYER_FN(fn_2)

ZMK_LAYER(system,                                                                                                                                                                                      \
     /* ╭─────────────┬─────────────┬─────────────┬─────────────┬─────────────┬─────────────╮                 ╭─────────────┬─────────────┬─────────────┬─────────────┬─────────────┬─────────────╮ */ \
          _____         &bt BT_DISC 0 &bt BT_DISC 1 &bt BT_DISC 2 &bt BT_DISC 3 &bt BT_DISC 4                   &dyn_nkro DYN_NKRO_TOG &dyn_nkro DYN_NKRO_NKRO &dyn_nkro DYN_NKRO_HKRO _____ _____ _____ \
     /* ├─────────────┼─────────────┼─────────────┼─────────────┼─────────────┼─────────────┤                 ├─────────────┼─────────────┼─────────────┼─────────────┼─────────────┼─────────────┤ */ \
          &bt BT_CLR    &bt BT_SEL 0  &bt BT_SEL 1  &bt BT_SEL 2  &bt BT_SEL 3  &bt BT_SEL 4                    _____         &out OUT_USB  &out OUT_BLE  _____         _____         _____            \
     /* ├─────────────┼─────────────┼─────────────┼─────────────┼─────────────┼─────────────┤                 ├─────────────┼─────────────┼─────────────┼─────────────┼─────────────┼─────────────┤ */ \
           _____         _____         _____         _____         _____         _____                          _____         _____         _____         _____         _____         _____            \
     /* ╰─────────────┴─────────────┴─────────────┴──────┬─────────────┬─────────────┬──────┴──────╮   ╭──────┴──────┬──────┴──────┬──────┴──────┬──────┴─────────────┴─────────────┴─────────────╯ */ \
                                                           _____         _____         _____             _____         _____         _____                                                             \
     /*                                                  ╰─────────────┴─────────────┴─────────────╯   ╰─────────────┴─────────────┴─────────────╯                                                  */ \
)

ZMK_LAYER(blank,                                                                                                                                                                                       \
     /* ╭─────────────┬─────────────┬─────────────┬─────────────┬─────────────┬─────────────╮                 ╭─────────────┬─────────────┬─────────────┬─────────────┬─────────────┬─────────────╮ */ \
          _____         _____         _____         _____         _____         _____                           _____         _____         _____         _____         _____         _____            \
     /* ├─────────────┼─────────────┼─────────────┼─────────────┼─────────────┼─────────────┤                 ├─────────────┼─────────────┼─────────────┼─────────────┼─────────────┼─────────────┤ */ \
          _____         _____         _____         _____         _____         _____                           _____         _____         _____         _____         _____         _____            \
     /* ├─────────────┼─────────────┼─────────────┼─────────────┼─────────────┼─────────────┤                 ├─────────────┼─────────────┼─────────────┼─────────────┼─────────────┼─────────────┤ */ \
          _____         _____         _____         _____         _____         _____                           _____         _____         _____         _____         _____         _____            \
     /* ╰─────────────┴─────────────┴─────────────┴──────┬─────────────┬─────────────┬──────┴──────╮   ╭──────┴──────┬──────┴──────┬──────┴──────┬──────┴─────────────┴─────────────┴─────────────╯ */ \
                                                           _____         _____         _____             _____         _____         _____                                                             \
     /*                                                  ╰─────────────┴─────────────┴─────────────╯   ╰─────────────┴─────────────┴─────────────╯                                                  */ \
)
